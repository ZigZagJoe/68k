#include <stdint.h>
#include <stdio.h>
#include <interrupts.h>
#include <io.h>
#include <flash.h>
#include <printf.h>

//loader-C built on Mon Jul 28 22:26:13 CDT 2014
unsigned char data[] = {
  0x00, 0x08, 0x00, 0x00, 0x00, 0x08, 0x00, 0x08, 0x13, 0xfc, 0x00, 0xba,
  0x00, 0x0c, 0x80, 0x00, 0x00, 0x7c, 0x07, 0x00, 0x13, 0xfc, 0x00, 0x10,
  0x00, 0x0c, 0x80, 0x00, 0x2e, 0x7c, 0x00, 0x08, 0x00, 0x00, 0x4e, 0x70,
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  0x49, 0x53, 0x52, 0x00
};
unsigned int data_len = 3460;


void mem_dump(uint8_t *addr, uint32_t cnt) {
    int c = 0;
    char ascii[17];
    ascii[16] = 0;
    
    putc('\n');
    
    printf("%8X   ", addr);
    for (uint32_t i = 0; i < cnt; i++) {
        uint8_t b = *addr;
        
        ascii[c] = (b > 31 & b < 127) ? b : '.';
        
        printf("%02X ",b);
        
        addr++;
        
        if (++c == 16) {
            puts("  ");
            puts(ascii);
            putc('\n');
            if ((i+1) < cnt)
                printf("%8X   ", addr);
            c = 0;
        }
    }
    
    if (c < 15) putc('\n');
}

int main() {
    TIL311 = 0x00;
    
    serial_start(SERIAL_SAFE);
    sei();

    mem_dump(0x80000,256);
   
    flash_arm(FLASH_ARM);
    flash_erase_sector(0);
    
  	mem_dump(0x80000,256);
   
    uint8_t error = 0;
    
    for (uint32_t i = 0; i < data_len; i++) {
    	flash_write_byte(ADDR(0x80000 + i), data[i]);
    	if (MEM(0x80000 + i) != data[i])
    		error = 1;
    }
    
    flash_arm(0);
    
    mem_dump(0x80000,256);
   
    TIL311 = error ? 0xEE : 0x0C;
    while(1);
}
